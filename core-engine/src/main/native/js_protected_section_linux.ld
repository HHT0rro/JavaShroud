SECTIONS
{
  .jskd ALIGN(CONSTANT(MAXPAGESIZE)) :
  {
    KEEP(*(.jskd))
    . = ALIGN(CONSTANT(MAXPAGESIZE));
  }

  .jsx ALIGN(CONSTANT(MAXPAGESIZE)) :
  {
    KEEP(*(.jsx))
    . = ALIGN(CONSTANT(MAXPAGESIZE));
  }
}
INSERT BEFORE .text;
